## config/boards/shields/nice_view_custom/Kconfig.defconfig
```kconfig
if SHIELD_NICE_VIEW_CUSTOM

config LV_Z_VDB_SIZE
    default 100

config LV_DPI_DEF
    default 161

config LV_Z_BITS_PER_PIXEL
    default 1

choice LV_COLOR_DEPTH
    default LV_COLOR_DEPTH_1
endchoice

choice ZMK_DISPLAY_STATUS_SCREEN
    default ZMK_DISPLAY_STATUS_SCREEN_CUSTOM
endchoice

config LV_Z_MEM_POOL_SIZE
    default 4096 if ZMK_DISPLAY_STATUS_SCREEN_CUSTOM

config NICE_VIEW_CUSTOM_WIDGET
    bool "Custom nice!view widget with per-half logos"
    default y
    select LV_FONT_MONTSERRAT_16
    select LV_USE_IMG
    select LV_USE_CANVAS

choice ZMK_DISPLAY_WORK_QUEUE
    default ZMK_DISPLAY_WORK_QUEUE_DEDICATED
endchoice

config ZMK_DISPLAY_DEDICATED_THREAD_STACK_SIZE
    default 2048

config ZMK_DISPLAY_DEDICATED_THREAD_PRIORITY
    default 5

endif
```

## config/boards/shields/nice_view_custom/Kconfig.shield
```kconfig
# Copyright (c) 2023 The ZMK Contributors
# SPDX-License-Identifier: MIT

config SHIELD_NICE_VIEW_CUSTOM
    def_bool $(shields_list_contains,nice_view_custom)
```

## config/west.yml
```yaml
manifest:
  remotes:
    - name: zmkfirmware
      url-base: https://github.com/zmkfirmware
  projects:
    - name: zmk
      remote: zmkfirmware
      revision: v0.3
      import: app/west.yml
    - name: corne-min-rgbled
      url: https://github.com/MechboardsLTD/zmk-module
      revision: corne-min-rgbled
    - name: corne-min-board
      url: https://github.com/MechboardsLTD/zmk-module
      revision: corne-min
    - name: prospector-module
      url: https://github.com/MechboardsLTD/zmk-module
      revision: prospector
    - name: zmk-helpers
      url: https://github.com/urob/zmk-helpers
      revision: main

  self:
    path: config
```
