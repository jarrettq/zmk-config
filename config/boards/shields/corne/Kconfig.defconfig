## config/boards/shields/corne_min_dongle/Kconfig.shield
```kconfig
# No whitespace after the comma or in the keyboard name!
config SHIELD_CORNE_MIN_DONGLE
    def_bool $(shields_list_contains,corne_min_dongle)
```

## config/boards/shields/nice_view/Kconfig.defconfig
```kconfig
# Copyright (c) 2023 The ZMK Contributors
# SPDX-License-Identifier: MIT

config ZMK_DISPLAY_CUSTOM_WIDGET
    bool "Use custom widgets for display"
    depends on ZMK_DISPLAY
    default n
    
config ZMK_DISPLAY_USE_COMPANY_LOGO
    bool "Use custom company logo on right display"
    depends on ZMK_DISPLAY
    default n
```
